## Config.in
```kconfig
config BR2SM_PROJECT_NAME
	string
	option env="PROJECT_NAME"

source "$BR2_EXTERNAL/package/genesis_ping/Config.in"
```

## configs/rpi_base_defconfig
```kconfig
BR2_arm=y
BR2_arm1176jzf_s=y
BR2_ARM_EABIHF=y
BR2_DEFCONFIG="/home/anthony/Development/egnss/egnss/defconfig"
BR2_DL_DIR="$(BR2_EXTERNAL)/dl"
BR2_CCACHE=y
BR2_OPTIMIZE_2=y
BR2_PACKAGE_OVERRIDE_FILE="$(BR2_EXTERNAL)/local.mk"
BR2_TOOLCHAIN_BUILDROOT_GLIBC=y
BR2_BINUTILS_VERSION_2_25=y
BR2_GCC_VERSION_4_9_X=y
BR2_TOOLCHAIN_BUILDROOT_CXX=y
BR2_GCC_ENABLE_LTO=y
BR2_ENABLE_LOCALE_PURGE=y
BR2_ENABLE_LOCALE_WHITELIST="C en_US"
BR2_GENERATE_LOCALE="en_US"
BR2_TARGET_OPTIMIZATION="-mfloat-abi=hard -mfpu=vfp"
BR2_TARGET_GENERIC_HOSTNAME="egnss"
BR2_TARGET_GENERIC_ISSUE="Welcome to Embedded GNSS (Base Station)"
BR2_ROOTFS_DEVICE_CREATION_DYNAMIC_MDEV=y
BR2_TARGET_GENERIC_ROOT_PASSWD="pi"
BR2_TARGET_GENERIC_GETTY_PORT="tty1"
BR2_TARGET_GENERIC_GETTY_BAUDRATE_38400=y
BR2_ROOTFS_OVERLAY="$(BR2_EXTERNAL)/board/egnss/rootfs_overlay" "$(BR2_EXTERNAL)/board/egnss/rootfs_overlay_bse"
BR2_ROOTFS_POST_BUILD_SCRIPT="$(BR2_EXTERNAL)/board/rpi/post-build.sh"
BR2_ROOTFS_POST_IMAGE_SCRIPT="$(BR2_EXTERNAL)/board/rpi/post-image.sh"
BR2_LINUX_KERNEL=y
BR2_LINUX_KERNEL_CUSTOM_GIT=y
BR2_LINUX_KERNEL_CUSTOM_REPO_URL="https://github.com/raspberrypi/linux"
BR2_LINUX_KERNEL_CUSTOM_REPO_VERSION="rpi-3.19.y"
BR2_LINUX_KERNEL_USE_CUSTOM_CONFIG=y
BR2_LINUX_KERNEL_CUSTOM_CONFIG_FILE="$(BR2_EXTERNAL)/board/rpi/linux-config"
BR2_LINUX_KERNEL_ZIMAGE=y
BR2_PACKAGE_BUSYBOX_WATCHDOG=y
BR2_PACKAGE_RPI_FIRMWARE=y
BR2_PACKAGE_DBUS=y
BR2_PACKAGE_RPI_USERLAND=y
BR2_PACKAGE_LIBRTLSDR=y
BR2_PACKAGE_LIBCOFI=y
BR2_PACKAGE_LIBGLIB2=y
BR2_PACKAGE_DROPBEAR=y
BR2_PACKAGE_IPTABLES=y
BR2_PACKAGE_IW=y
BR2_PACKAGE_WIRELESS_TOOLS=y
BR2_PACKAGE_WIRELESS_TOOLS_LIB=y
BR2_PACKAGE_WPA_SUPPLICANT=y
BR2_PACKAGE_WPA_SUPPLICANT_AP_SUPPORT=y
BR2_PACKAGE_WPA_SUPPLICANT_EAP=y
BR2_PACKAGE_WPA_SUPPLICANT_HOTSPOT=y
BR2_PACKAGE_WPA_SUPPLICANT_DEBUG_SYSLOG=y
BR2_PACKAGE_WPA_SUPPLICANT_WPS=y
BR2_PACKAGE_WPA_SUPPLICANT_CLI=y
BR2_PACKAGE_WPA_SUPPLICANT_PASSPHRASE=y
BR2_PACKAGE_WPA_SUPPLICANT_DBUS_NEW=y
BR2_PACKAGE_NANO=y
BR2_TARGET_ROOTFS_EXT2=y
BR2_TARGET_ROOTFS_EXT2_4=y
BR2_TARGET_ROOTFS_EXT2_LABEL="egnss-root"
# BR2_TARGET_ROOTFS_TAR is not set
BR2_PACKAGE_HOST_DOSFSTOOLS=y
BR2_PACKAGE_HOST_MTOOLS=y
BR2_PACKAGE_HOST_UTIL_LINUX=y
BR2_PACKAGE_GENSESIS_PING=y
```

## egnss_rpi_defconfig
```kconfig
BR2_arm=y
BR2_arm1176jzf_s=y
BR2_DEFCONFIG="/home/anthony/Development/egnss/egnss/defconfig"
BR2_DL_DIR="$(BR2_EXTERNAL)/dl"
BR2_CCACHE=y
BR2_PACKAGE_OVERRIDE_FILE="$(BR2_EXTERNAL)/local.mk"
BR2_GLOBAL_PATCH_DIR="$(BR2_EXTERNAL)/patch"
BR2_TOOLCHAIN_BUILDROOT_LARGEFILE=y
BR2_TOOLCHAIN_BUILDROOT_INET_IPV6=y
BR2_TOOLCHAIN_BUILDROOT_INET_RPC=y
BR2_TOOLCHAIN_BUILDROOT_LOCALE=y
BR2_BINUTILS_VERSION_2_25=y
BR2_GCC_VERSION_4_9_X=y
BR2_TOOLCHAIN_BUILDROOT_CXX=y
BR2_GCC_ENABLE_LTO=y
BR2_ENABLE_LOCALE_PURGE=y
BR2_ENABLE_LOCALE_WHITELIST="C en_US"
BR2_GENERATE_LOCALE="en_US"
BR2_TARGET_OPTIMIZATION="-pipe -mfloat-abi=hard -mpfu=vfp"
BR2_TARGET_GENERIC_HOSTNAME="egnss"
BR2_TARGET_GENERIC_ISSUE="Welcome to Embedded GNSS"
BR2_ROOTFS_DEVICE_CREATION_DYNAMIC_MDEV=y
BR2_TARGET_GENERIC_ROOT_PASSWD="pi"
BR2_TARGET_GENERIC_GETTY_PORT="tty1"
BR2_TARGET_GENERIC_GETTY_BAUDRATE_38400=y
BR2_ROOTFS_OVERLAY="$(BR2_EXTERNAL)/overlay"
BR2_LINUX_KERNEL=y
BR2_LINUX_KERNEL_CUSTOM_GIT=y
BR2_LINUX_KERNEL_CUSTOM_REPO_URL="https://github.com/raspberrypi/linux"
BR2_LINUX_KERNEL_CUSTOM_REPO_VERSION="rpi-3.19.y"
BR2_LINUX_KERNEL_DEFCONFIG="bcmrpi"
BR2_LINUX_KERNEL_ZIMAGE=y
BR2_LINUX_KERNEL_INSTALL_TARGET=y
BR2_PACKAGE_BUSYBOX_WATCHDOG=y
BR2_PACKAGE_RPI_USERLAND=y
BR2_PACKAGE_GNURADIO=y
BR2_PACKAGE_GNURADIO_BLOCKS=y
BR2_PACKAGE_GNURADIO_PYTHON=y
BR2_PACKAGE_DROPBEAR=y
BR2_PACKAGE_WIRELESS_TOOLS=y
BR2_PACKAGE_WIRELESS_TOOLS_LIB=y
BR2_PACKAGE_NANO=y
BR2_TARGET_ROOTFS_TAR_GZIP=y
```

## package/genesis_ping/Config.in
```kconfig
config BR2_PACKAGE_GENSESIS_PING
	bool "genesis_ping"
	depends on BR2_INSTALL_LIBSTDCPP
	depends on BR2_TOOLCHAIN_HAS_THREADS
    select BR2_PACKAGE_BOOST
    select BR2_PACKAGE_BOOST_SYSTEM
	help
	 Broadcasts udp packets to Genesis

	 https://github.com/anthony-arnold/genesis

comment "genesis_ping needs a toolchain w/ C++, threads"
	depends on !(BR2_INSTALL_LIBSTDCPP && BR2_TOOLCHAIN_HAS_THREADS)
```

## package/gflags/Config.in
```kconfig
config BR2_PACKAGE_GFLAGS
	bool "gflags"
	depends on BR2_INSTALL_LIBSTDCPP
	depends on BR2_TOOLCHAIN_HAS_THREADS
	help
	 The gflags package contains a library that implements commandline flags processing.
	 It includes built-in support for C++ types like string and the ability to define
	 flags in the source file in which they're used.

	 https://code.google.com/p/gflags/


comment "glog needs a toolchain w/ C++, threads"
	depends on !(BR2_INSTALL_LIBSTDCPP && BR2_TOOLCHAIN_HAS_THREADS)
```

## package/glog/Config.in
```kconfig
config BR2_PACKAGE_GLOG
       bool "glog"
       help
         C++ implementation of the Google logging module

	 https://github.com/google/glog
```

## package/gnss-sdr/Config.in
```kconfig
config BR2_PACKAGE_GNSS_SDR
    bool "gnss-sdr"
    select BR2_PACKAGE_GNURADIO
    select BR2_PACKAGE_OPENSSL
    select BR2_PACKAGE_GTEST
    select BR2_PACKAGE_ORC
    select BR2_PACKAGE_ARMADILLO
    select BR2_PACKAGE_BOOST_CHRONO
    select BR2_PACKAGE_BOOST_SERIALIZATION
    select BR2_PACKAGE_BOOST_TEST
    select BR2_PACKAGE_BOOST
    select BR2_PACKAGE_BOOST_DATE_TIME
    select BR2_PACKAGE_BOOST_FILESYSTEM
    select BR2_PACKAGE_BOOST_PROGRAM_OPTIONS
    select BR2_PACKAGE_BOOST_SYSTEM
    select BR2_PACKAGE_BOOST_THREAD
    select BR2_PACKAGE_GFLAGS
    select BR2_PACKAGE_GLOG
    help
      Software-defined satellite navigation

      http://gnss-sdr.org/

config BR2_PACKAGE_GNSS_SDR_OSMOSDR
    bool "OsmoSDR support"
    depends on BR2_PACKAGE_GNSS_SDR
    select BR2_PACKAGE_LIBUSB
    select BR2_PACKAGE_GROSMOSDR
    help
      enable OsmoSDR interface
```

## package/gnuradio-blocks/Config.in
```kconfig
config BR2_PACKAGE_GNURADIO_ANALOG
    bool "analog communications support"
    depends on BR2_PACKAGE_GNURADIO_FFT_OK
    select BR2_PACKAGE_GNURADIO_FILTER
    help
      GNU Radio blocks for analog communications

config BR2_PACKAGE_GNURADIO_CHANNELS
    bool "channels model blocks support"
    depends on BR2_PACKAGE_GNURADIO_FFT_OK
    select BR2_PACKAGE_GNURADIO_ANALOG
    help
      GNU Radio's channel model blocks

config BR2_PACKAGE_GNURADIO_DIGITAL
    bool "digital communications support"
    depends on BR2_PACKAGE_GNURADIO_FFT_OK
    select BR2_PACKAGE_GNURADIO_ANALOG
    help
      GNU Radio blocks for digital communications

config BR2_PACKAGE_GNURADIO_FEC
    bool "FEC signal processing support"
    select BR2_PACKAGE_GNURADIO_BLOCKS
    depends on BR2_PACKAGE_GNURADIO
    help
      GNU Radio's FEC signal processing blocks

config BR2_PACKAGE_GNURADIO_FFT_OK
    bool
    default y
    depends on BR2_PACKAGE_FFTW_PRECISION_SINGLE

config BR2_PACKAGE_GNURADIO_FFT
    bool "fft blocks support"
    depends on BR2_PACKAGE_GNURADIO_FFT_OK
    select BR2_PACKAGE_GNURADIO_BLOCKS
    help
      GNU Radio's FFT signal processing blocks

comment "gr-fft depends on fftw and fftw's single precision"
    depends on !BR2_PACKAGE_FFTW_PRECISION_SINGLE

config BR2_PACKAGE_GNURADIO_FILTER
    bool "signal processing filter blocks support"
    depends on BR2_PACKAGE_GNURADIO_FFT_OK
    select BR2_PACKAGE_GNURADIO_FFT
    help
      GNU Radio's filter signal processing blocks

config BR2_PACKAGE_GNURADIO_PAGER
    bool "FLEX pager decoder support"
    depends on BR2_PACKAGE_GNURADIO_FFT_OK
    select BR2_PACKAGE_GNURADIO_ANALOG
    help
     GNU Radio blocks implementing a FLEX pager decoder

config BR2_PACKAGE_GNURADIO_TRELLIS
    bool "trellis coded modulation support"
    depends on BR2_PACKAGE_GNURADIO_FFT_OK
    select BR2_PACKAGE_GNURADIO_DIGITAL
    help
      GNU Radio blocks for trellis coded modulation

config BR2_PACKAGE_GNURADIO_UTILS
    bool "misc python utilities support"
    select BR2_PACKAGE_GNURADIO_PYTHON
    depends on BR2_PACKAGE_GNURADIO
    help
      GNU Radio misc python utilities

comment "gr-filter, -analog, -channels, -digital, -trellis, -pager depends on gr-fft"
    depends on !BR2_PACKAGE_GNURADIO_FFT_OK
```

## package/gr-osmosdr/Config.in
```kconfig
config BR2_PACKAGE_GROSMOSDR
       bool "gr-osmosdr"
       select BR2_PACKAGE_OSMOSDR
       select BR2_PACKAGE_LIBUSB
       select BR2_PACKAGE_GNURADIO
       select BR2_PACKAGE_RTLSDR
       help
         Osmocom Gnu Radio Blocks

	 http://sdr.osmocom.org/trac/wiki/GrOsmoSDR
```

## package/osmosdr/Config.in
```kconfig
config BR2_PACKAGE_OSMOSDR
	bool "osmosdr"
	select BR2_PACKAGE_LIBUSB
    help
     OsmoSDR is a 100% Free Software based small form-factor inexpensive SDR (Software Defined Radio) project.

	 http://sdr.osmocom.org
```

## package/rtlsdr/Config.in
```kconfig
config BR2_PACKAGE_RTLSDR
	bool "rtlsdr"
	depends on BR2_INSTALL_LIBSTDCPP
	depends on BR2_TOOLCHAIN_HAS_THREADS
	help
	 DVB-T dongles based on the Realtek RTL2832U can be used as a cheap SDR, since the chip allows transferring the raw I/Q samples to the host, which is officially used for DAB/DAB+/FM demodulation. The possibility of this has been discovered by Eric Fry.

	 http://sdr.osmocom.org/trac/wiki/rtl-sdr
```
